## conf/machine/dev-armv7.conf
```bitbake
#@TYPE: Machine
#@NAME: dev-armv7
#@DESCRIPTION: Machine configuration for the armv7 of meta-dev.

DEFAULTTUNE ?= "cortexa9thf-neon"

require conf/machine/include/tune-cortexa9.inc

# File System Configuration
IMAGE_FSTYPES ?= "tar.gz cpio cpio.gz.u-boot"

KERNEL_DEFCONFIG = "dev_armv7_zybo_defconfig"

#MACHINE_ESSENTIAL_EXTRA_RDEPENDS_remove = "device-tree"

#KERNEL_DEVICETREE = "zynq-zybo.dtb"

#UBOOT_MACHINE ?= "zynq_zybo_config"

#EXTRA_IMAGEDEPENDS += "u-boot-dev"
```

## meta-reference/meta/conf/layer.conf
```bitbake
# We have a conf and classes directory, add to BBPATH
BBPATH .= ":${LAYERDIR}"
# We have recipes-* directories, add to BBFILES
BBFILES += "${LAYERDIR}/recipes-*/*/*.bb"

BBFILE_COLLECTIONS += "core"
BBFILE_PATTERN_core = "^${LAYERDIR}/"
BBFILE_PRIORITY_core = "5"
```
